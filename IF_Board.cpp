/******************************************************************************
*
* EXPRESS RECEIVER by AD5GH
* (http://www.expressreceiver.com)
* ARDUINO MEGA DISPLAY & CONTROL BOARD SOFTWARE
* IF_BOARD ROUTINES
*
* Copyright 2017 Rod Gatehouse AD5GH
* Distributed under the terms of the MIT License:
* http://www.opensource.org/licenses/mit-license
*
* VERSION 1.0.9
* December 27, 2017
*
******************************************************************************/

#include <Function.h>
#include <IF_Board.h>
#include "Adafruit_LiquidCrystal.h"

#define I2C_IF_Board 0x10 >> 1

#define SLOW  0                                 // AGC settings
#define FAST  1
#define MAN   2

#define S_METER_PERIOD  1                       // s-meter update period, multiple of heart beat period

/******************************************************************************/

Function _function;

Adafruit_LiquidCrystal sMeterLCD(2);

uint8_t AGC_Mode;

uint8_t S_Meter_Update = S_METER_PERIOD;

uint8_t S_Meter_Hist[10];
uint8_t peakCount = 0;

const char L2_S0[21] = {0x20, 0x20, 0x20, 0x20, 0x20, 0x20, 0x20, 0x20, 0x20, 0x20, 0x20, 0x20, 0x20, 0x20, 0x20, 0x20, 0x20, 0x20, 0x20, 0x20, '\0'};
const char L2_S1[21] = {'1', 0x20, 0x20, 0x20, 0x20, 0x20, 0x20, 0x20, 0x20, 0x20, 0x20, 0x20, 0x20, 0x20, 0x20, 0x20, 0x20, 0x20, 0x20, 0x20, '\0'};
const char L2_S2[21] = {0x20, '2', 0x20, 0x20, 0x20, 0x20, 0x20, 0x20, 0x20, 0x20, 0x20, 0x20, 0x20, 0x20, 0x20, 0x20, 0x20, 0x20, 0x20, 0x20, '\0'};
const char L2_S3[21] = {0x20, 0x20, '3', 0x20, 0x20, 0x20, 0x20, 0x20, 0x20, 0x20, 0x20, 0x20, 0x20, 0x20, 0x20, 0x20, 0x20, 0x20, 0x20, 0x20, '\0'};
const char L2_S4[21] = {0x20, 0x20, 0x20, '4', 0x20, 0x20, 0x20, 0x20, 0x20, 0x20, 0x20, 0x20, 0x20, 0x20, 0x20, 0x20, 0x20, 0x20, 0x20, 0x20, '\0'};
const char L2_S5[21] = {0x20, 0x20, 0x20, 0x20, '5', 0x20, 0x20, 0x20, 0x20, 0x20, 0x20, 0x20, 0x20, 0x20, 0x20, 0x20, 0x20, 0x20, 0x20, 0x20, '\0'};
const char L2_S6[21] = {0x20, 0x20, 0x20, 0x20, 0x20, '6', 0x20, 0x20, 0x20, 0x20, 0x20, 0x20, 0x20, 0x20, 0x20, 0x20, 0x20, 0x20, 0x20, 0x20, '\0'};
const char L2_S7[21] = {0x20, 0x20, 0x20, 0x20, 0x20, 0x20, '7', 0x20, 0x20, 0x20, 0x20, 0x20, 0x20, 0x20, 0x20, 0x20, 0x20, 0x20, 0x20, 0x20, '\0'};
const char L2_S8[21] = {0x20, 0x20, 0x20, 0x20, 0x20, 0x20, 0x20, '8', 0x20, 0x20, 0x20, 0x20, 0x20, 0x20, 0x20, 0x20, 0x20, 0x20, 0x20, 0x20, '\0'};
const char L2_S9[21] = {0x20, 0x20, 0x20, 0x20, 0x20, 0x20, 0x20, 0x20, '9', 0x20, 0x20, 0x20, 0x20, 0x20, 0x20, 0x20, 0x20, 0x20, 0x20, 0x20, '\0'};
const char L2_S9_10[21] = {0x20, 0x20, 0x20, 0x20, 0x20, 0x20, 0x20, 0x20, 0x20, '+', '1', '0', 0x20, 0x20, 0x20, 0x20, 0x20, 0x20, 0x20, 0x20, '\0'};
const char L2_S9_20[21] = {0x20, 0x20, 0x20, 0x20, 0x20, 0x20, 0x20, 0x20, 0x20, 0x20, '+', '2', '0', 0x20, 0x20, 0x20, 0x20, 0x20, 0x20, 0x20, '\0'};
const char L2_S9_30[21] = {0x20, 0x20, 0x20, 0x20, 0x20, 0x20, 0x20, 0x20, 0x20, 0x20, 0x20, '+', '3', '0', 0x20, 0x20, 0x20, 0x20, 0x20, 0x20, '\0'};
const char L2_S9_40[21] = {0x20, 0x20, 0x20, 0x20, 0x20, 0x20, 0x20, 0x20, 0x20, 0x20, 0x20, 0x20, '+', '4', '0', 0x20, 0x20, 0x20, 0x20, 0x20, '\0'};
const char L2_S9_50[21] = {0x20, 0x20, 0x20, 0x20, 0x20, 0x20, 0x20, 0x20, 0x20, 0x20, 0x20, 0x20, 0x20, '+', '5', '0', 0x20, 0x20, 0x20, 0x20, '\0'};
const char L2_S9_60[21] = {0x20, 0x20, 0x20, 0x20, 0x20, 0x20, 0x20, 0x20, 0x20, 0x20, 0x20, 0x20, 0x20, 0x20, '+', '6', '0', 0x20, 0x20, 0x20, '\0'};

const char L3_S0[21] = {0x20, 0x20, 0x20, 0x20, 0x20, 0x20, 0x20, 0x20, 0x20, 0x20, 0x20, 0x20, 0x20, 0x20, 0x20, 0x20, 0x20, 0x20, 0x20, 0x20, '\0'};
const char L3_S1[21] = {0xFF, 0x20, 0x20, 0x20, 0x20, 0x20, 0x20, 0x20, 0x20, 0x20, 0x20, 0x20, 0x20, 0x20, 0x20, 0x20, 0x20, 0x20, 0x20, 0x20, '\0'};
const char L3_S2[21] = {0xFF, 0xFF, 0x20, 0x20, 0x20, 0x20, 0x20, 0x20, 0x20, 0x20, 0x20, 0x20, 0x20, 0x20, 0x20, 0x20, 0x20, 0x20, 0x20, 0x20, '\0'};
const char L3_S3[21] = {0xFF, 0xFF, 0xFF, 0x20, 0x20, 0x20, 0x20, 0x20, 0x20, 0x20, 0x20, 0x20, 0x20, 0x20, 0x20, 0x20, 0x20, 0x20, 0x20, 0x20, '\0'};
const char L3_S4[21] = {0xFF, 0xFF, 0xFF, 0xFF, 0x20, 0x20, 0x20, 0x20, 0x20, 0x20, 0x20, 0x20, 0x20, 0x20, 0x20, 0x20, 0x20, 0x20, 0x20, 0x20, '\0'};
const char L3_S5[21] = {0xFF, 0xFF, 0xFF, 0xFF, 0xFF, 0x20, 0x20, 0x20, 0x20, 0x20, 0x20, 0x20, 0x20, 0x20, 0x20, 0x20, 0x20, 0x20, 0x20, 0x20, '\0'};
const char L3_S6[21] = {0xFF, 0xFF, 0xFF, 0xFF, 0xFF, 0xFF, 0x20, 0x20, 0x20, 0x20, 0x20, 0x20, 0x20, 0x20, 0x20, 0x20, 0x20, 0x20, 0x20, 0x20, '\0'};
const char L3_S7[21] = {0xFF, 0xFF, 0xFF, 0xFF, 0xFF, 0xFF, 0xFF, 0x20, 0x20, 0x20, 0x20, 0x20, 0x20, 0x20, 0x20, 0x20, 0x20, 0x20, 0x20, 0x20, '\0'};
const char L3_S8[21] = {0xFF, 0xFF, 0xFF, 0xFF, 0xFF, 0xFF, 0xFF, 0xFF, 0x20, 0x20, 0x20, 0x20, 0x20, 0x20, 0x20, 0x20, 0x20, 0x20, 0x20, 0x20, '\0'};
const char L3_S9[21] = {0xFF, 0xFF, 0xFF, 0xFF, 0xFF, 0xFF, 0xFF, 0xFF, 0xFF, 0x20, 0x20, 0x20, 0x20, 0x20, 0x20, 0x20, 0x20, 0x20, 0x20, 0x20, '\0'};
const char L3_S9_10[21] = {0xFF, 0xFF, 0xFF, 0xFF, 0xFF, 0xFF, 0xFF, 0xFF, 0xFF, 0xFF, 0x20, 0x20, 0x20, 0x20, 0x20, 0x20, 0x20, 0x20, 0x20, 0x20, '\0'};
const char L3_S9_20[21] = {0xFF, 0xFF, 0xFF, 0xFF, 0xFF, 0xFF, 0xFF, 0xFF, 0xFF, 0xFF, 0xFF, 0x20, 0x20, 0x20, 0x20, 0x20, 0x20, 0x20, 0x20, 0x20, '\0'};
const char L3_S9_30[21] = {0xFF, 0xFF, 0xFF, 0xFF, 0xFF, 0xFF, 0xFF, 0xFF, 0xFF, 0xFF, 0xFF, 0xFF, 0x20, 0x20, 0x20, 0x20, 0x20, 0x20, 0x20, 0x20, '\0'};
const char L3_S9_40[21] = {0xFF, 0xFF, 0xFF, 0xFF, 0xFF, 0xFF, 0xFF, 0xFF, 0xFF, 0xFF, 0xFF, 0xFF, 0xFF, 0x20, 0x20, 0x20, 0x20, 0x20, 0x20, 0x20, '\0'};
const char L3_S9_50[21] = {0xFF, 0xFF, 0xFF, 0xFF, 0xFF, 0xFF, 0xFF, 0xFF, 0xFF, 0xFF, 0xFF, 0xFF, 0xFF, 0xFF, 0x20, 0x20, 0x20, 0x20, 0x20, 0x20, '\0'};
const char L3_S9_60[21] = {0xFF, 0xFF, 0xFF, 0xFF, 0xFF, 0xFF, 0xFF, 0xFF, 0xFF, 0xFF, 0xFF, 0xFF, 0xFF, 0xFF, 0xFF, 0x20, 0x20, 0x20, 0x20, 0x20, '\0'};


IF_Board::IF_Board(void)
{

}

void IF_Board::begin(void)
{
    sMeterLCD.begin(20, 4);
}


void IF_Board::splash(void)
{
  sMeterLCD.print(F("       AD5GH        "));
  sMeterLCD.setCursor(0, 1);
  sMeterLCD.print(F("  EXPRESS RECEIVER  "));
  sMeterLCD.setCursor(0, 2);
  sMeterLCD.print(F("  HF UP CONVERTING  "));
  sMeterLCD.setCursor(0, 3);
  sMeterLCD.print(F(" SUPER HET RECEIVER "));
}


void IF_Board::sMeterInit(void)
{
  sMeterLCD.clear();
  sMeterLCD.setCursor(0, 0);
  sMeterLCD.print(F("      S-Meter"));
}


void IF_Board::setAGCMode(uint8_t agcMode)
{
    uint8_t temp;
    temp = _function.getManualIFGain();
    Wire.beginTransmission(I2C_IF_Board);
    Wire.write(agcMode + (temp << 3));
    Wire.endTransmission();
    if(agcMode == MAN)
    {
        sMeterLCD.setCursor(0, 2);
        sMeterLCD.print(F("                    "));
        _function.manIFGainSetDisplay(temp);
    }
    AGC_Mode = agcMode;
}


void IF_Board::setManIFGain(void)
{
    Wire.beginTransmission(I2C_IF_Board);
    Wire.write(MAN + (_function.getManualIFGain() << 3));
    Wire.endTransmission();
}


void IF_Board::getSMeterReading(void)
{
    uint8_t Sig_Strength = 0xFF;

    uint8_t S_Mtr_Cmnd = 0x06;

    if(AGC_Mode == MAN) 
        {
            delay(250);
            return;
        }

    if (--S_Meter_Update == 0)
    {
        S_Meter_Update = S_METER_PERIOD;

        Wire.requestFrom(I2C_IF_Board, (uint8_t) 1);
        if(Wire.available()) Sig_Strength = Wire.read();
        Wire.endTransmission();

        if(Sig_Strength > 199) updateSMeterDsply(0);                               //S0
        else if(Sig_Strength <= 199 && Sig_Strength > 194) updateSMeterDsply(1);   //S1
        else if(Sig_Strength <= 194 && Sig_Strength > 188) updateSMeterDsply(2);   //S2
        else if(Sig_Strength <= 188 && Sig_Strength > 172) updateSMeterDsply(3);   //S3
        else if(Sig_Strength <= 172 && Sig_Strength > 158) updateSMeterDsply(4);   //S4
        else if(Sig_Strength <= 158 && Sig_Strength > 143) updateSMeterDsply(5);   //S5
        else if(Sig_Strength <= 143 && Sig_Strength > 130) updateSMeterDsply(6);   //S6
        else if(Sig_Strength <= 130 && Sig_Strength > 117) updateSMeterDsply(7);   //S7
        else if(Sig_Strength <= 117 && Sig_Strength > 106) updateSMeterDsply(8);   //S8
        else if(Sig_Strength <= 106 && Sig_Strength > 88) updateSMeterDsply(9);    //S9
        else if(Sig_Strength <= 88 && Sig_Strength > 73) updateSMeterDsply(10);    //+10
        else if(Sig_Strength <= 73 && Sig_Strength > 58) updateSMeterDsply(11);    //+20
        else if(Sig_Strength <= 58 && Sig_Strength > 45) updateSMeterDsply(12);    //+30
        else if(Sig_Strength <= 45 && Sig_Strength > 41) updateSMeterDsply(13);    //+40
        else if(Sig_Strength <= 41 && Sig_Strength > 40) updateSMeterDsply(14);    //+50
        else if(Sig_Strength <= 40) updateSMeterDsply(15);                         //+60

    }
}


void IF_Board::updateSMeterDsply(uint8_t S_Level)
{
    unsigned char peak, c;

    S_Meter_Hist[peakCount] = S_Level;
    peakCount++;
    if(peakCount == 10) peakCount = 0;
    
    peak = S_Meter_Hist[0];
 
    for (c = 1; c < 10; c++)
    {
        if (S_Meter_Hist[c] > peak) peak  = S_Meter_Hist[c];
    }

    sMeterLCD.setCursor(0, 3);
    switch (S_Level)
    {
        case 0:
            sMeterLCD.print(L3_S0);
            break;

        case 1:
            sMeterLCD.print(L3_S1);
            break;

        case 2:
            sMeterLCD.print(L3_S2);
            break;

        case 3:
            sMeterLCD.print(L3_S3);
            break;

        case 4:
            sMeterLCD.print(L3_S4);
            break;

        case 5:
            sMeterLCD.print(L3_S5);
            break;

        case 6:
            sMeterLCD.print(L3_S6);
            break;

        case 7:
            sMeterLCD.print(L3_S7);
            break;

        case 8:
            sMeterLCD.print(L3_S8);
            break;

        case 9:
            sMeterLCD.print(L3_S9);
            break;

        case 10:
            sMeterLCD.print(L3_S9_10);
            break;

        case 11:
            sMeterLCD.print(L3_S9_20);
            break;

        case 12:
            sMeterLCD.print(L3_S9_30);
            break;

        case 13:
            sMeterLCD.print(L3_S9_40);
            break;

        case 14:
            sMeterLCD.print(L3_S9_50);
            break;

        case 15:
            sMeterLCD.print(L3_S9_60);
            break;
    }

    sMeterLCD.setCursor(0, 2);
    switch (peak)
    {
        case 0:
            sMeterLCD.print(L2_S0);
            break;

        case 1:
            sMeterLCD.print(L2_S1);
            break;

        case 2:
            sMeterLCD.print(L2_S2);
            break;

        case 3:
            sMeterLCD.print(L2_S3);
            break;

        case 4:
            sMeterLCD.print(L2_S4);
            break;

        case 5:
            sMeterLCD.print(L2_S5);
            break;

        case 6:
            sMeterLCD.print(L2_S6);
            break;

        case 7:
            sMeterLCD.print(L2_S7);
            break;

        case 8:
            sMeterLCD.print(L2_S8);
            break;

        case 9:
            sMeterLCD.print(L2_S9);
            break;

        case 10:
            sMeterLCD.print(L2_S9_10);
            break;

        case 11:
            sMeterLCD.print(L2_S9_20);
            break;

        case 12:
            sMeterLCD.print(L2_S9_30);
            break;

        case 13:
            sMeterLCD.print(L2_S9_40);
            break;

        case 14:
            sMeterLCD.print(L2_S9_50);
            break;

        case 15:
            sMeterLCD.print(L2_S9_60);
            break;
    }
}